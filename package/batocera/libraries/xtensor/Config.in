## package/batocera/libraries/xtensor/Config.in
```kconfig
config BR2_PACKAGE_XTENSOR
	bool "xtensor"
	depends on BR2_INSTALL_LIBSTDCPP
	select BR2_PACKAGE_XTL
	help
	  xtensor is a C++ library meant for numerical analysis with
	  multi-dimensional array expressions. It is header-only.

	  https://github.com/xtensor-stack/xtensor

comment "xtensor needs a toolchain w/ C++"
	depends on !BR2_INSTALL_LIBSTDCPP
```

## package/batocera/libraries/xtl/Config.in
```kconfig
config BR2_PACKAGE_XTL
	bool "xtl"
	depends on BR2_INSTALL_LIBSTDCPP
	help
	  xtl (eXtended Template Library) is a C++ header-only library
	  providing basic tensor (multidimensional arrays) functionality.
	  It is required by xtensor.

	  https://github.com/xtensor-stack/xtl

comment "xtl needs a toolchain w/ C++"
	depends on !BR2_INSTALL_LIBSTDCPP
```

## package/batocera/npu/rknpu-driver/Config.in
```kconfig
config BR2_PACKAGE_RKNPU_DRIVER
	bool "rknpu-driver"
	depends on BR2_PACKAGE_BATOCERA_TARGET_RK3588
	depends on BR2_LINUX_KERNEL
	select BR2_LINUX_NEEDS_MODULES
	help
	  Install the RKNPU kernel driver for Rockchip RK3588 NPU acceleration.
	  This package provides the kernel module source code that will be
	  compiled and installed for NPU functionality on RK3588 platforms.

	  https://github.com/airockchip/rknn-llm
```

## package/batocera/utils/batocera-steam/Config.in
```kconfig
config BR2_PACKAGE_BATOCERA_STEAM
	bool "batocera-steam"
	depends on BR2_x86_64 || BR2_aarch64

	select BR2_PACKAGE_FLATPAK
	select BR2_PACKAGE_FEX_EMU if BR2_aarch64
```

## package/batocera/utils/fex-emu/Config.in
```kconfig
config BR2_PACKAGE_FEX_EMU
	bool "fex-emu"
	depends on BR2_aarch64
	help
	  FEX is a fast usermode x86 and x86-64 emulator for arm64 Linux.
	  It JIT-translates x86(-64) instructions to arm64 and registers
	  itself with the kernel's binfmt_misc so x86(-64) ELF binaries
	  are transparently launched through it. This is the same
	  translation layer Valve bundles into Proton for Steam Frame /
	  SteamOS on arm64.

	  Running x86(-64) binaries also requires an x86 RootFS (fetched
	  at runtime via FEXRootFSFetcher) providing x86 shared libraries.

	  https://github.com/FEX-Emu/FEX
```

## package/batocera/utils/local-llm/Config.in
```kconfig
config BR2_PACKAGE_LOCAL_LLM
	bool "local-llm"
	depends on BR2_PACKAGE_SDL2
	select BR2_PACKAGE_JSON_FOR_MODERN_CPP
	select BR2_PACKAGE_PORTAUDIO
	select BR2_PACKAGE_PORTAUDIO_ALSA
	select BR2_PACKAGE_XTENSOR
	select BR2_PACKAGE_OPUS
	select BR2_PACKAGE_LIBOPUSENC
	select BR2_PACKAGE_LIBSOXR
	help
	  Custom AI pipeline optimized for embedded platforms.
	  Includes Speech-to-Text (Sherpa), Large Language Model (RKLLM),
	  and Text-to-Speech (Paroli) capabilities.

	  https://github.com/amrmantawi/local-llm
```
